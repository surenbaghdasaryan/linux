## drivers/staging/ctagmod_noleak/Kconfig
```kconfig
# SPDX-License-Identifier: GPL-2.0
config CTAGMOD_NOLEAK
	tristate "Code tagging test module with no leaks"
	depends on CODE_TAGGING
	default m
	help
	  Code tagging test module with no leaks.

	  To compile this driver as a module, choose M here: the module
	  will be called ctagmod.
```
